// GENERATED from config-catalog.json by scripts/generate_config_explain.py - DO NOT EDIT.
// catalog sha256[:16] = fe41dfb4dc9e40e2
  {"ip","concept","A number that names one device on a network, like a street address. Written as four parts, e.g. 10.13.37.10.","","",""},
  {"mask","concept","Decides which addresses count as 'my local network' versus 'somewhere else I reach through the gateway'. 255.255.255.0 means the first three parts must match to be local.","Passed to the W5500 (eth_begin) or the WiFi stack (setup_wifi WiFi.config) as the netmask; the IP stack ANDs it with each destination to pick local-vs-routed.","",""},
  {"gateway","concept","The address the device sends traffic to when the destination is NOT on its own local network - the door to everywhere else.","Stored as eth_gw / wifi_gw and loaded at bring-up. Note: in DHCP mode the firmware ADOPTS the gateway the DHCP server hands out.","Because the gateway is also the default NTP source, a rogue DHCP server that names itself the gateway becomes the device's time source - the AiTM path explored in the NTP lab (Part 8).",""},
  {"dhcp","concept","DHCP = the network hands the device an address automatically. Static = you pin a fixed address yourself.","use_static flips eth_begin/setup_wifi between Ethernet.begin(mac, ip, ...) (static) and a DHCP lease request; on DHCP the firmware also adopts the leased gateway/DNS.","DHCP trusts whatever answers first. A rogue DHCP server can hand out its own address as gateway+DNS+NTP (option 42) and sit in the middle. Static addressing removes that attack surface - one reason ICS networks pin PLC addresses.",""},
  {"sta_ap","concept","STA (station) = the device JOINS a WiFi network you already have. AP (access point) = the device HOSTS its own little network that you connect to.","wifi_mode selects WiFi.mode(WIFI_STA) + WiFi.begin(ssid,pass) vs WiFi.mode(WIFI_AP) + WiFi.softAP(ssid,pass) in setup_wifi.","An AP that anyone can join, or that keeps a default password, is an open door to the controller - see the setup-AP credential note.",""},
  {"wifi_mode","wifi","Off = no WiFi radio (contained). STA = join your network. AP = host a setup network.","wifi_mode drives setup_wifi(): WIFI_OFF / WIFI_STA+begin / WIFI_AP+softAP.","Leaving WiFi Off is the contained default - enabling a radio widens the attack surface, so do it only on an isolated segment.","netcfg wifi off | sta <ssid> <pass> | ap [<ssid> <pass>]"},
  {"ssid","wifi","The name of the WiFi network you want the device to JOIN (station mode).","ssid -> WiFi.begin(ssid, pass).","","netcfg wifi sta <ssid> <pass>"},
  {"pass","wifi","The password for the WiFi network you're joining.","pass -> WiFi.begin(ssid, pass). Stored in NVS; the config JSON never returns it.","Treated as a secret: the device's /api/config and netcfg json never echo it back.","netcfg wifi sta <ssid> <pass>"},
  {"wifi_addr","wifi","Whether the WiFi interface gets its address automatically (DHCP, usual on a home/office LAN) or fixed (Static).","wifi_use_static; setup_wifi() calls WiFi.config(ip,gw,mask) only when static.","","netcfg wifi static <ip> <gw> <mask>  |  netcfg wifi dhcp"},
  {"wifi_ip","wifi","A fixed address for the device on your WiFi network (static mode only).","wifi_ip -> WiFi.config().","","netcfg wifi static <ip> <gw> <mask>"},
  {"wifi_gw","wifi","The router on your WiFi network (static mode only).","wifi_gw -> WiFi.config().","","netcfg wifi static <ip> <gw> <mask>"},
  {"wifi_mask","wifi","Which WiFi addresses are local vs. routed (static mode only).","wifi_mask -> WiFi.config().","","netcfg wifi static <ip> <gw> <mask>"},
  {"ap_ssid","wifi","The name of the temporary WiFi network the device hosts in AP mode so you can set it up.","ap_ssid, or a default built from the chip's MAC (setup_ap_ssid -> esp_read_mac) so two boards don't collide; WiFi.softAP(ssid,pass).","",""},
  {"ap_pass","wifi","The password for the device's own setup network.","ap_pass or the documented default (setup_ap_pass); WiFi.softAP(ssid, pass) - WPA2, min 8 chars.","The DEFAULT password is a deliberate teaching weakness (CWE-798/1392, hard-coded/default credentials): a device left on its default AP password is trivially joined. Change it, or use AP only briefly to provision then switch to STA/Off.",""},
  {"eth_present","ethernet","Whether the wired-Ethernet add-on (the W5500 PoE module) is physically fitted.","eth_ok() returns true when Ethernet.hardwareStatus() detects the W5500 chip over SPI at boot; the config UI hides/greys the Ethernet section when it's false.","",""},
  {"eth_mode","ethernet","Whether the wired interface gets its address automatically (DHCP) or uses a fixed one you set (Static).","eth_use_static; eth_begin() branches on it.","","netcfg eth static <ip> <gw> <mask>  |  netcfg eth dhcp"},
  {"eth_ip","ethernet","The fixed address other machines use to reach this device over the wired network.","eth_ip -> the W5500 source-IP register via eth_begin() before any socket opens.","","netcfg eth static <ip> <gw> <mask>"},
  {"eth_gw","ethernet","The router address the wired interface uses to reach other networks.","eth_gw; also the default NTP source when no NTP server is set.","","netcfg eth static <ip> <gw> <mask>"},
  {"eth_mask","ethernet","Which wired addresses count as local vs. routed through the gateway.","eth_mask -> W5500 subnet register.","","netcfg eth static <ip> <gw> <mask>"},
  {"ntp","shared","The server the device asks for the current time. Blank means 'use the gateway'.","ntp (empty -> eth_gw) passed to time_sync_set_server().","If time comes from the gateway and the gateway came from DHCP, whoever controls DHCP controls the clock - the NTP AiTM / Y2038 lab (Part 8).","netcfg ntp <ip> [port]"},
  {"cfg_cred","shared","The username and password that protect the device's web/API configuration.","cfg_user/cfg_pass checked by the web server's basic-auth on /api/config.","Ships as admin/openplc - a default credential (CWE-798/1392). Anyone who can reach the web page can reconfigure the device until you change it.","netcfg auth <user> <pass>"},
